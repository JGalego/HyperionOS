## boot/configs/hyperion_aarch64_virt_defconfig
```kconfig
BR2_aarch64=y
BR2_TOOLCHAIN_BUILDROOT_GLIBC=y
BR2_PACKAGE_HOST_LINUX_HEADERS_CUSTOM_6_18=y
BR2_GLOBAL_PATCH_DIR="board/qemu/patches"
BR2_DOWNLOAD_FORCE_CHECK_HASHES=y
# See hyperion_x86_64_efi_defconfig's own comment: real image build reproducibility needed both
# this (build-timestamp/build-path determinism) and a pinned rootfs UUID (below) -- confirmed by
# actually rebuilding identical source twice and diffing the real output hashes, not assumed.
BR2_REPRODUCIBLE=y
BR2_SYSTEM_DHCP="eth0"
BR2_ROOTFS_DEVICE_CREATION_DYNAMIC_EUDEV=y
BR2_ROOTFS_OVERLAY="board/hyperion-aarch64/rootfs-overlay"
BR2_ROOTFS_POST_BUILD_SCRIPT="board/hyperion-aarch64/post-build.sh"
BR2_LINUX_KERNEL=y
BR2_LINUX_KERNEL_CUSTOM_VERSION=y
BR2_LINUX_KERNEL_CUSTOM_VERSION_VALUE="6.18.7"
BR2_LINUX_KERNEL_USE_CUSTOM_CONFIG=y
BR2_LINUX_KERNEL_CUSTOM_CONFIG_FILE="board/hyperion-aarch64/linux.config"
BR2_LINUX_KERNEL_INSTALL_TARGET=y
BR2_LINUX_KERNEL_NEEDS_HOST_OPENSSL=y
BR2_LINUX_KERNEL_NEEDS_HOST_LIBELF=y
BR2_TARGET_ROOTFS_EXT2=y
BR2_TARGET_ROOTFS_EXT2_4=y
BR2_TARGET_ROOTFS_EXT2_SIZE="180M"
# Pins the rootfs's own ext4 filesystem UUID (a different fixed value than the x86_64 board's own
# so the two platforms' rootfs images never collide if ever mounted on the same real host at once)
# AND its own directory hash seed -- mke2fs generates the hash seed randomly *independent* of -U,
# deliberately, as an anti-hash-flooding security measure for htree directory lookups; found as a
# second, separate non-reproducibility cause on the x86_64 board (see that defconfig's own
# comment) and fixed identically here.
BR2_TARGET_ROOTFS_EXT2_MKFS_OPTIONS="-O ^64bit -U 48000000-0000-0000-0000-000000000002 -E hash_seed=48000000-0000-0000-3000-000000000002"
# BR2_TARGET_ROOTFS_TAR is not set
```

## boot/configs/hyperion_x86_64_efi_defconfig
```kconfig
BR2_x86_64=y
BR2_TOOLCHAIN_BUILDROOT_GLIBC=y
BR2_PACKAGE_HOST_LINUX_HEADERS_CUSTOM_6_12=y
BR2_TARGET_GENERIC_GETTY_PORT="tty1"
BR2_GLOBAL_PATCH_DIR="board/pc/patches"
BR2_DOWNLOAD_FORCE_CHECK_HASHES=y
# Real image build reproducibility: BR2_REPRODUCIBLE removes build-timestamp/build-path
# non-determinism from the toolchain/packaging steps themselves. It does NOT cover a filesystem's
# own randomly-assigned UUID (mke2fs's own runtime randomness, a separate source this defconfig's
# own MKFS_OPTIONS line below pins) -- confirmed the hard way: two back-to-back builds of identical
# source produced two different disk.img SHA-256 hashes before this fix, traced to PARTUUID (read
# from the rootfs's own random UUID) differing every build and landing in both GRUB's cmdline and
# the GPT table.
BR2_REPRODUCIBLE=y
BR2_ROOTFS_DEVICE_CREATION_DYNAMIC_EUDEV=y
BR2_ROOTFS_OVERLAY="board/hyperion-x86_64/rootfs-overlay"
BR2_ROOTFS_POST_BUILD_SCRIPT="board/hyperion-x86_64/post-build.sh"
BR2_ROOTFS_POST_IMAGE_SCRIPT="board/hyperion-x86_64/post-image.sh"
BR2_LINUX_KERNEL=y
BR2_LINUX_KERNEL_CUSTOM_VERSION=y
BR2_LINUX_KERNEL_CUSTOM_VERSION_VALUE="6.12.47"
BR2_LINUX_KERNEL_USE_CUSTOM_CONFIG=y
BR2_LINUX_KERNEL_CUSTOM_CONFIG_FILE="board/hyperion-x86_64/linux.config"
BR2_LINUX_KERNEL_INSTALL_TARGET=y
BR2_LINUX_KERNEL_NEEDS_HOST_OPENSSL=y
BR2_LINUX_KERNEL_NEEDS_HOST_LIBELF=y
BR2_TARGET_ROOTFS_EXT2=y
BR2_TARGET_ROOTFS_EXT2_4=y
BR2_TARGET_ROOTFS_EXT2_SIZE="180M"
# Pins the rootfs's own ext4 filesystem UUID (leaks into GRUB's root=PARTUUID=... cmdline and the
# GPT table -- the first non-reproducibility cause found) AND its own directory hash seed
# (mke2fs generates this randomly *independent* of -U, deliberately, as an anti-hash-flooding
# security measure for htree directory lookups -- found as the *second*, separate cause: the two
# UUID-pinning fixes above alone were not sufficient, confirmed by two more back-to-back rebuilds
# that still produced different hashes until this was added too).
BR2_TARGET_ROOTFS_EXT2_MKFS_OPTIONS="-O ^64bit -U 48000000-0000-0000-0000-000000000001 -E hash_seed=48000000-0000-0000-3000-000000000001"
# BR2_TARGET_ROOTFS_TAR is not set
BR2_TARGET_GRUB2=y
BR2_TARGET_GRUB2_X86_64_EFI=y
BR2_PACKAGE_HOST_DOSFSTOOLS=y
BR2_PACKAGE_HOST_GENIMAGE=y
BR2_PACKAGE_HOST_MTOOLS=y
```
